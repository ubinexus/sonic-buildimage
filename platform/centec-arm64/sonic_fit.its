## platform/centec-arm64/sonic_fit.its
```
/*
 *Copyright 2018 CENTEC
 *
 */

/dts-v1/;

/ {
	description = "arm64 kernel, initramfs and FDT blob";	
	#address-cells = <1>;
    
	images {
		kernel_ctc {
			description = "ARM64 Kernel";			
			data = /incbin/("./vmlinuz-5.10.0-23-2-arm64");
			type = "kernel";			
			arch = "arm64";			
			os = "linux";			
			compression = "none";			
			load = <0x80080000>;			
			entry = <0x80080000>;			
			hash {				
				algo = "crc32";			
			};
		};
		initramfs {
			description = "initramfs";
			data = /incbin/("./initrd.img-5.10.0-23-2-arm64");
			type = "ramdisk";
			arch = "arm64";
			os = "linux";
			compression = "gzip";
			load = <0x00000000>;
			entry = <0x00000000>;
			hash {				
				algo = "crc32";			
			};
		};
		ctc_fdt {
			description = "dtb for phytium";			
			data = /incbin/("./phytium-d2000.dtb");			
			type = "flat_dt";
			arch = "arm64";			
			os = "linux";			
			compression = "none";					
			hash {				
				algo = "crc32";			
			};
		};
	};
	configurations {
		default = "phytium-d2000";
					
		phytium-d2000 {			
			description = "config for phytium_d2000";			
			kernel = "kernel_ctc";			
			ramdisk = "initramfs";			
			fdt = "ctc_fdt";		
			};
	};
};
```
